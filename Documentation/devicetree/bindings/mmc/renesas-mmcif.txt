## drivers/gpu/ion/Kconfig
```kconfig
menuconfig ION
	tristate "Ion Memory Manager"
	depends on ARM
	select GENERIC_ALLOCATOR
	select DMA_SHARED_BUFFER
	help
	  Chose this option to enable the ION Memory Manager.

config ION_TEGRA
	tristate "Ion for Tegra"
	depends on ARCH_TEGRA && ION
	help
	  Choose this option if you wish to use ion on an nVidia Tegra.

config ION_R_MOBILE
        tristate "Ion for R-Mobile"
        depends on ARCH_SHMOBILE && ION
        select ARM_HAS_SG_CHAIN
        help
          Choose this option if you wish to use ion on Renesas R-Mobile.

config ION_R_MOBILE_USE_BOOTLOADER_AREA
	bool "Use bootloader area as ION carveout heap"
	depends on ION_R_MOBILE
	default n
	help
	  Choose this option if you wish to re-use the bootloader area
	  reserved(removed) from linux as a ION carveout heap.
```

## drivers/gpu/pvr/Kconfig
```kconfig
config POWERVR_SGX
	tristate "PowerVR SGX"
	depends on ARCH_SHMOBILE
	default y
	help
	  Driver for PowerVR SGX hardware.

	  Say Y here if your SoC contains a PowerVR SGX GPU. For more
	  information, see <http://www.imgtec.com/powervr/>.
```

## drivers/input/touchscreen/bcmtch15xxx/Kconfig
```kconfig
#
# BROADCOM Touchscreen driver configuration
#

config TOUCHSCREEN_BCMTCH15XXX
	tristate "Broadcom 15xxx touchscreen interface"
	depends on I2C
	help
	  Say Y here to support the BCMTCH15XXX touchscreen
	  controller on a I2C bus

	  To compile this driver as a module, choose M here: the
	  module will be called bcmtch15xxx.
```

## drivers/input/touchscreen/ektf2k/Kconfig
```kconfig
#
# RMI4 configuration
#
config TOUCHSCREEN_EKTF2K
	bool "Elan touch controller support"
	help
	  Say Y here if you want to support the ektf2k bus.
	  If unsure, say Y.
```

## drivers/input/touchscreen/ft5336/Kconfig
```kconfig
#
# FT5336 Touchscreen driver configuration
#

config TOUCHSCREEN_FT5336
	tristate "Focal Tech FT5336 touchscreen interface"
	depends on I2C
	help
	  Say Y here to support the  FT5336 touchscreen
	  controller on a I2C bus

	  To compile this driver as a module, choose M here: the
	  module will be called ft5336.
```

## drivers/input/touchscreen/synaptic_rmi4/Kconfig
```kconfig
#
# RMI4 configuration
#
config TOUCHSCREEN_SYNAPTIC_RMI4
	tristate "Synaptics RMI4 bus support"
	help
	  Say Y here if you want to support the Synaptics RMI4 bus.
	  If unsure, say N.
	  To compile this driver as a module, choose M here: the
	  module will be called synaptic_tp.ko.
```

## drivers/media/i2c/soc_camera/Kconfig
```kconfig
comment "soc_camera sensor drivers"

config SOC_CAMERA_IMX074
	tristate "imx074 support"
	depends on SOC_CAMERA && I2C
	help
	  This driver supports IMX074 cameras from Sony

config SOC_CAMERA_MT9M001
	tristate "mt9m001 support"
	depends on SOC_CAMERA && I2C
	help
	  This driver supports MT9M001 cameras from Micron, monochrome
	  and colour models.

config SOC_CAMERA_MT9M111
	tristate "mt9m111, mt9m112 and mt9m131 support"
	depends on SOC_CAMERA && I2C
	help
	  This driver supports MT9M111, MT9M112 and MT9M131 cameras from
	  Micron/Aptina

config SOC_CAMERA_MT9T031
	tristate "mt9t031 support"
	depends on SOC_CAMERA && I2C
	help
	  This driver supports MT9T031 cameras from Micron.

config SOC_CAMERA_MT9T112
	tristate "mt9t112 support"
	depends on SOC_CAMERA && I2C
	help
	  This driver supports MT9T112 cameras from Aptina.

config SOC_CAMERA_MT9V022
	tristate "mt9v022 and mt9v024 support"
	depends on SOC_CAMERA && I2C
	help
	  This driver supports MT9V022 cameras from Micron

config SOC_CAMERA_OV2640
	tristate "ov2640 camera support"
	depends on SOC_CAMERA && I2C
	help
	  This is a ov2640 camera driver

config SOC_CAMERA_OV5642
	tristate "ov5642 camera support"
	depends on SOC_CAMERA && I2C
	help
	  This is a V4L2 camera driver for the OmniVision OV5642 sensor

config SOC_CAMERA_OV6650
	tristate "ov6650 sensor support"
	depends on SOC_CAMERA && I2C
	---help---
	  This is a V4L2 SoC camera driver for the OmniVision OV6650 sensor

config SOC_CAMERA_OV772X
	tristate "ov772x camera support"
	depends on SOC_CAMERA && I2C
	help
	  This is a ov772x camera driver

config SOC_CAMERA_OV9640
	tristate "ov9640 camera support"
	depends on SOC_CAMERA && I2C
	help
	  This is a ov9640 camera driver

config SOC_CAMERA_OV9740
	tristate "ov9740 camera support"
	depends on SOC_CAMERA && I2C
	help
	  This is a ov9740 camera driver

config SOC_CAMERA_OV5645
	tristate "ov5645 camera support"
	depends on SOC_CAMERA && I2C
	help
	  This driver supports OV5645 cameras from Omnivision
	  This supports auto focus
	  The LED flash has been implemented in the driver
	  Added new function to support exp time

config SOC_CAMERA_OV5645_TUNING
	tristate "ov5645 tuning support"
	depends on SOC_CAMERA_OV5645 && I2C
	help
	  This driver supports OV5645 tuning cameras from Omnivision
	  This supports auto focus
	  The LED flash has been implemented in the driver
	  Added new function to support exp time

config SOC_CAMERA_HM2056
        tristate "hm2056 camera support"
        depends on SOC_CAMERA && I2C
        help
          This driver supports HM2056 cameras from Omnivision
          This supports auto focus
          The LED flash has been implemented in the driver
          Added new function to support exp time

config SOC_CAMERA_HM2056_TUNING
        tristate "hm2056 tuning support"
        depends on SOC_CAMERA_HM2056 && I2C
        help
          This driver supports HM2056 tuning cameras from Omnivision
          This supports auto focus
          The LED flash has been implemented in the driver
          Added new function to support exp time

config SOC_CAMERA_GC0310
        tristate "GC0310 camera support"
        depends on SOC_CAMERA && I2C
        help
          This driver supports GC0310 cameras from GalaxyCore
          GC0310 is a VGA sensor.

config SOC_CAMERA_T8EV5
        tristate "T8EV5 camera support"
        depends on SOC_CAMERA && I2C
        help
          This driver supports T8EV5 cameras from Toshiba
          T8EV5 is a 5MP sensor with AF support.

config SOC_CAMERA_SP1628
        tristate "SP1628 camera support"
        depends on SOC_CAMERA && I2C
        help
          This driver supports SP1628 cameras from SuperPix
          SP1628 is a 1,2MP sensor.

config SOC_CAMERA_RJ54N1
	tristate "rj54n1cb0c support"
	depends on SOC_CAMERA && I2C
	help
	  This is a rj54n1cb0c video driver

config SOC_CAMERA_S5K4ECGX
	tristate "s5k4ecgx support"
	depends on SOC_CAMERA && I2C
	help
	  This driver supports S5K4ECGX cameras from Samsung

config SOC_CAMERA_S5K4ECGX_TUNING
	tristate "s5k4ecgx tuning support"
	depends on SOC_CAMERA_S5K4ECGX && I2C
	help
	  This driver supports S5K4ECGX tuning cameras from Samsung

config SOC_CAMERA_ISX012
	tristate "isx012 support"
	depends on SOC_CAMERA && I2C
	help
	  This driver supports ISX012 cameras from Samsung

config SOC_CAMERA_ISX012_TUNING
	tristate "isx012 tuning support"
	depends on SOC_CAMERA_ISX012 && I2C
	help
	  This driver supports ISX012 tuning cameras from Samsung

config SOC_CAMERA_DB8V61M
        tristate "db8v61m support"
        depends on SOC_CAMERA && I2C
        help
          This driver supports DB8V61M camera

config SOC_CAMERA_DB8V61M_TUNING
        tristate "db8v61m tuning support"
        depends on SOC_CAMERA_DB8V61M && I2C
        help
          This driver supports DB8V61M tuning camera

config SOC_CAMERA_SR030PC50
	tristate "sr030pc50 support"
	depends on SOC_CAMERA && I2C
	help
	  This driver supports SR030PC50 cameras from siliconfile

config SOC_CAMERA_SR030PC50_TUNING
	tristate "sr030pc50 tuning support"
	depends on SOC_CAMERA_SR030PC50 && I2C
	help
	  This driver supports SR030PC50 tuning cameras from Samsung

config SOC_CAMERA_DB8V61M
	tristate "db8v61m support"
	depends on SOC_CAMERA && I2C
	help
	  This driver supports DB8V61M cameras from Samsung

config SOC_CAMERA_DB8V61M_TUNING
	tristate "db8v61m tuning support"
	depends on SOC_CAMERA_DB8V61M && I2C
	help
	  This driver supports DB8V61M tuning cameras from Samsung

config SOC_CAMERA_SR200PC20M
	tristate "sr200pc20m support"
	depends on SOC_CAMERA && I2C
	help
	  This driver supports SR200PC20M cameras from Samsung

config SOC_CAMERA_SR200PC20M_TUNING
	tristate "sr200pc20m tuning support"
	depends on SOC_CAMERA_SR200PC20M && I2C
	help
	  This driver supports SR200PC20M tuning cameras from Samsung

config SOC_CAMERA_SR352
	tristate "sr352 support"
	depends on SOC_CAMERA && I2C
	help
	  This driver supports SR352 cameras from Samsung
	  SR-352 is a 3M pixcel single chip CMOS image sensor
	  for mobile phone camera applications and digital still
	  camera products.

config SOC_CAMERA_SR352_TUNING
	tristate "sr352 tuning support"
	depends on SOC_CAMERA_SR352 && I2C
	help
	  This driver supports SR352 tuning cameras from Samsung
	  SR-352 is a 3M pixcel single chip CMOS image sensor
	  for mobile phone camera applications and digital still
	  camera products.

config SOC_CAMERA_SR130PC20
	tristate "sr130pc20 support"
	depends on SOC_CAMERA && I2C
	help
	  This driver supports SR130PC20 cameras from siliconfile.
	  SR130PC20 is a 1.3M pixcel single chip CMOS image sensor
	  for mobile phone camera applications and digital still
	  camera products.

config SOC_CAMERA_SR130PC20_TUNING
	tristate "sr130pc20 tuning support"
	depends on SOC_CAMERA_SR130PC20 && I2C
	help
	  This driver supports SR130PC20 tuning cameras from Samsung

config SOC_CAMERA_TW9910
	tristate "tw9910 support"
	depends on SOC_CAMERA && I2C
	help
	  This is a tw9910 video driver
```

## drivers/net/wireless/bcm_wlan/Kconfig
```kconfig
# Connectivity

config BCM_WLAN
	tristate "WLAN host perf driver"
	help
		Broadcom's WLAN driver for interface
		handling and performance
```

## drivers/net/wireless/bcmdhd/Kconfig
```kconfig
config BCMDHD
	tristate "Broadcom wireless cards support"
	depends on WLAN
	---help---
	  This module adds support for wireless adapters based on
	  Broadcom WLAN chipset.

config BCMDHD_SDIO
	bool "SDIO bus interface support"
	depends on BCMDHD && MMC
	default y	

config BCMDHD_PCIE
	bool "PCIe bus interface support"
	depends on BCMDHD && PCI && !BCMDHD_SDIO

config BCMDHD_FW_PATH
	depends on BCMDHD
	string "Firmware path"
	default "/system/vendor/firmware/fw_wifi.bin"
	---help---
	  Path to the firmware file.

config BCMDHD_NVRAM_PATH
	depends on BCMDHD
	string "NVRAM path"
	default "/system/vendor/firmware/fw_wifi_nvram.txt"
	---help---
	  Path to the calibration file.

config BCMDHD_WEXT
	bool "Enable WEXT support"
	depends on BCMDHD && CFG80211 = n
	select WIRELESS_EXT
	select WEXT_PRIV
	help
	  Enables WEXT support

config DHD_USE_STATIC_BUF
	bool "Enable memory preallocation"
	depends on BCMDHD
	default n
	---help---
	  Use memory preallocated in platform

config DHD_USE_SCHED_SCAN
	bool "Use CFG80211 sched scan"
	depends on BCMDHD && CFG80211
	default n
	---help---
	  Use CFG80211 sched scan
```

## drivers/thermal/sh_thermal/Kconfig
```kconfig
#
# SH thermal configuration
#
config SH_THERMAL
	tristate "SH Mobile thermal driver"
	depends on THERMAL
	depends on ARCH_SHMOBILE
	help
	  Enables SH thermal driver to monitor temperature
	  levels and thermal throttling.

config HOTPLUG_THERMAL
	tristate "Hotplug coolant"
	depends on SH_THERMAL
	help
	  Enables generic hotplug thermal coolant for thermal
	  throttling.
```

## drivers/video/r-mobile/Kconfig
```kconfig
config FB_SH_MOBILE_LCDC
        tristate "SuperH Mobile LCDC framebuffer support"
        depends on FB && (SUPERH || ARCH_SHMOBILE) && HAVE_CLK
        select FB_SYS_FILLRECT
        select FB_SYS_COPYAREA
        select FB_SYS_IMAGEBLIT
        select FB_SYS_FOPS
        select FB_DEFERRED_IO
        select FB_BACKLIGHT
        select SH_MIPI_DSI if SH_LCD_MIPI_DSI
        ---help---
          Frame buffer driver for the on-chip SH-Mobile LCD controller.

config FB_LCD_ESD
        boolean "LCD ESD RECOVERY by interrupt"

config LCD_ESD_RECOVERY_BY_CHECK_REG
        boolean "LCD ESD RECOVERY by checking register"

choice
        depends on FB_SH_MOBILE_LCDC
        prompt "hdmi select"
        default FB_R_MOBILE_HDMI_KOTA
        help
          Selected hdmi

config FB_R_MOBILE_HDMI_KOTA
        boolean "KOTA HDMI"

endchoice

config FB_SH_MOBILE_DOUBLE_BUF
        bool "SuperH Mobile double buffer support"
        depends on FB_SH_MOBILE_LCDC
        default y
        help
          SuperH Mobile LCDC framebuffer support double buffer.

config FB_SH_MOBILE_RGB888
        bool "SuperH Mobile RGB888 support"
        depends on FB_SH_MOBILE_LCDC
        default n
        help
          SuperH Mobile LCDC framebuffer support RGB888.

config LDI_MDNIE
	bool "mobile Digital Natural Image engine"
	help
	  This feature is used to control the display sharpness, backlight control
	  as per the contents to be displayed
	  This also provides support for CABC feature
```
