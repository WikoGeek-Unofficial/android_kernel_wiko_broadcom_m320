## Documentation/devicetree/bindings/mmc/renesas-mmcif.txt
```
* Renesas Multi Media Card Interface

The Renesas MMCIF module is a host interface supports JEDEC STANDARD
JESD84-A441. This module allows connection with Multi Media Card.

This file documents differences between the core properties in mmc.txt
and the properties used by the renesas_mmcif driver.

Required properties
- compatible: Should be "renesas,renesas-mmcif" for r8a7373 board.

Optional properties:
- renesas,sup-pclk: set if host clock is not supplied
- renesas,dma-min-size: minimum data size to use dma channel.
  Otherwise use pio.
- renesas,buf-acc: Buffer access config register. Determines the
  mode of DMA transfer
- data-delay-ps: Output data delay selection register (CE_DELAY_SEL)

Example:
mmcif: mmcif@e6bd0000 {
	compatible = "renesas,renesas-mmcif";
	reg = <0xe6bd0000 0x100>;
	interrupt-parent = <&gic>;
	interrupts = <0 122 0x4>;
	bus-width = <8>;
	max-frequency = <52000000>;
	status = "disabled";
	non-removable;
	cap-mmc-highspeed;
	renesas,sup-pclk = <0>;
	renesas,dma-min-size = <0>;
	renesas,buf-acc = <0>;
	renesas,data-delay-ps = <0>;
};
```

## Documentation/devicetree/bindings/mmc/renesas-sdhi.txt
```
* Renesas SD Host Interface

The Renesas SD Host Interface provides an interface for SD and SDIO type of
memory cards.

This file documents differences between the core properties described
by mmc.txt and the properties used by the renesas_sdhi driver.

Required properties:
 - compatible: Should be "renesas,sdhi-r8a7373" for r8a7373 board.

Optional properties:
 - renesas,dma-en-val : enables or disables DMA mode. Set 0x2 to enable.
   0 means disable.
 - renesas,dma-alignment : DMA alignment size. Default is 2.
 - renesas,dma-min-size : minimum data size to use dma transfer. Default value
   is 8.
 - renesas,detect-irq : external card detect irq.
 - renesas,detect-msec : specifies msecs delay between detect interrupt
   detect work queue.
 - renesas,card-stat-sysfs : if present, card status will be exported into
   sysfs.
 - renesas,sdhi-wp-disable : sets the RENESAS_SDHI_WP_DISABLE flag which will
   disable write protection check.
 - renesas,sdhi-sdclk-offen : Enable Card clock auto off.
 - renesas,sdhi-sdclk-div1 : Enable SDCLK div 1.
 - renesas,sdhi-dma-slave-config : Runtime DMA config support
 - renesas,pm-ignore-pm-notify : sets MMC_PM_IGNORE_PM_NOTIFY pm_caps flag
   to ignore mmc pm notify.
 - renesas,suspend-pwr-ctrl : Restore the power status after suspend resume.

Example:
sdhi0: sdhi@ee100000 {
        compatible = "renesas,sdhi-r8a7373";
        reg = <0xee100000 0x100>;
        interrupt-parent = <&gic>;
        interrupts = <GIC_SPI 118 IRQ_TYPE_LEVEL_HIGH>;
        renesas,dma-en-val = <0>;
        renesas,dma-alignment = <0>;
        renesas,dma-min-size = <0>;
        renesas,detect-irq = <2050>;
        renesas,detect-msec = <0>;
        renesas,card-stat-sysfs;
        renesas,sdhi-wp-disable;
        renesas,sdhi-sdclk-offen;
        renesas,sdhi-sdclk-div1;
};
```

## arch/arm/configs/mobicore_defconfig
```kconfig
CONFIG_MOBICORE_DRIVER=y
#CONFIG_MOBICORE_DEBUG is not set
#CONFIG_MOBICORE_VERBOSE is not set
CONFIG_MOBICORE_API=y
```

## arch/arm/configs/u2_afyonlte_rev000_defconfig
```kconfig
# CONFIG_LOCALVERSION_AUTO is not set
CONFIG_SYSVIPC=y
CONFIG_POSIX_MQUEUE=y
CONFIG_AUDIT=y
CONFIG_NO_HZ=y
CONFIG_HIGH_RES_TIMERS=y
CONFIG_LOG_BUF_SHIFT=20
CONFIG_CGROUPS=y
CONFIG_CGROUP_FREEZER=y
CONFIG_CGROUP_CPUACCT=y
CONFIG_RESOURCE_COUNTERS=y
CONFIG_CGROUP_SCHED=y
CONFIG_RT_GROUP_SCHED=y
CONFIG_BLK_CGROUP=y
CONFIG_NAMESPACES=y
# CONFIG_UTS_NS is not set
# CONFIG_IPC_NS is not set
# CONFIG_PID_NS is not set
CONFIG_RELAY=y
CONFIG_BLK_DEV_INITRD=y
CONFIG_PANIC_TIMEOUT=2
CONFIG_EXPERT=y
CONFIG_PERF_EVENTS=y
CONFIG_MODULES=y
CONFIG_MODULE_FORCE_LOAD=y
CONFIG_MODULE_UNLOAD=y
CONFIG_MODVERSIONS=y
# CONFIG_BLK_DEV_BSG is not set
CONFIG_PARTITION_ADVANCED=y
# CONFIG_IOSCHED_DEADLINE is not set
CONFIG_CFQ_GROUP_IOSCHED=y
CONFIG_ARCH_SHMOBILE=y
CONFIG_ARCH_R8A7373=y
CONFIG_MACH_AFYONLTE=y
CONFIG_MACH_U2USB=y
CONFIG_U2_TIMERS=y
CONFIG_U2_SDHI=y
CONFIG_U2_TOUCHPANEL=y
CONFIG_MEMORY_SIZE=0x10000000
CONFIG_SHMOBILE_TIMER_HZ=100
# CONFIG_SH_TIMER_CMT_ARM is not set
CONFIG_CPUFREQ_SUPPORT=y
# CONFIG_MUX_STM_TO_SDHI1 is not set
CONFIG_ARM_TZ=y
CONFIG_SHMOBILE_CPUFREQ=y
CONFIG_PDC=y
CONFIG_RENESAS_DUMMY_NETDEV=y
CONFIG_RENESAS_MDMLOADER=y
CONFIG_RENESAS=y
CONFIG_GPS_BCM4752=y
CONFIG_FLASH_RT8547=y
# CONFIG_SWP_EMULATE is not set
CONFIG_CACHE_PL310_INSN_PREFETCH=y
CONFIG_CACHE_PL310_DATA_PREFETCH=y
CONFIG_CACHE_PL310_PREFETCH_DOUBLE_LINEFILL=y
CONFIG_CACHE_PL310_PREFETCH_DROP=y
CONFIG_CACHE_PL310_STANDBY_MODE=y
CONFIG_CACHE_PL310_DYNAMIC_CLOCK_GATING=y
CONFIG_ARM_ERRATA_754322=y
CONFIG_ARM_ERRATA_764369=y
CONFIG_SMP=y
CONFIG_SCHED_MC=y
CONFIG_SCU_STANDBY=y
CONFIG_SCU_IC_STANDBY=y
CONFIG_PREEMPT=y
CONFIG_AEABI=y
# CONFIG_OABI_COMPAT is not set
CONFIG_HIGHMEM=y
# CONFIG_BOUNCE is not set
CONFIG_KSM=y
# CONFIG_ATAGS is not set
CONFIG_ZBOOT_ROM_TEXT=0x0
CONFIG_ZBOOT_ROM_BSS=0x0
CONFIG_KEXEC=y
CONFIG_CPU_FREQ=y
CONFIG_CPU_FREQ_GOV_USERSPACE=y
CONFIG_CPU_FREQ_GOV_ONDEMAND=y
CONFIG_DYNAMIC_DOWN_DIFF=y
CONFIG_DYNAMIC_SAMPLING_RATE=y
CONFIG_CPU_IDLE=y
CONFIG_VFP=y
CONFIG_NEON=y
# CONFIG_CORE_DUMP_DEFAULT_ELF_HEADERS is not set
CONFIG_PM_AUTOSLEEP=y
CONFIG_PM_WAKELOCKS=y
CONFIG_PM_RUNTIME=y
CONFIG_PM_DEBUG=y
CONFIG_SUSPEND_TIME=y
CONFIG_NET=y
CONFIG_PACKET=y
CONFIG_UNIX=y
CONFIG_XFRM_USER=y
CONFIG_NET_KEY=y
CONFIG_INET=y
CONFIG_IP_ADVANCED_ROUTER=y
CONFIG_IP_MULTIPLE_TABLES=y
CONFIG_IP_ROUTE_VERBOSE=y
CONFIG_IP_PNP=y
CONFIG_IP_PNP_DHCP=y
CONFIG_INET_AH=y
CONFIG_INET_ESP=y
# CONFIG_INET_LRO is not set
# CONFIG_INET_DIAG is not set
CONFIG_IPV6=y
CONFIG_IPV6_PRIVACY=y
CONFIG_IPV6_ROUTER_PREF=y
CONFIG_IPV6_ROUTE_INFO=y
CONFIG_IPV6_OPTIMISTIC_DAD=y
CONFIG_INET6_AH=y
CONFIG_INET6_ESP=y
CONFIG_INET6_IPCOMP=y
CONFIG_IPV6_MIP6=y
CONFIG_IPV6_TUNNEL=y
CONFIG_IPV6_MULTIPLE_TABLES=y
CONFIG_IPV6_SUBTREES=y
CONFIG_NETFILTER=y
CONFIG_NF_CONNTRACK=y
CONFIG_NF_CONNTRACK_SECMARK=y
CONFIG_NF_CONNTRACK_EVENTS=y
CONFIG_NF_CT_PROTO_DCCP=y
CONFIG_NF_CT_PROTO_SCTP=y
CONFIG_NF_CT_PROTO_UDPLITE=y
CONFIG_NF_CONNTRACK_AMANDA=y
CONFIG_NF_CONNTRACK_FTP=y
CONFIG_NF_CONNTRACK_H323=y
CONFIG_NF_CONNTRACK_IRC=y
CONFIG_NF_CONNTRACK_NETBIOS_NS=y
CONFIG_NF_CONNTRACK_PPTP=y
CONFIG_NF_CONNTRACK_SANE=y
CONFIG_NF_CONNTRACK_SIP=y
CONFIG_NF_CONNTRACK_TFTP=y
CONFIG_NF_CT_NETLINK=y
CONFIG_NETFILTER_TPROXY=y
CONFIG_NETFILTER_XT_TARGET_CLASSIFY=y
CONFIG_NETFILTER_XT_TARGET_CONNMARK=y
CONFIG_NETFILTER_XT_TARGET_CONNSECMARK=y
CONFIG_NETFILTER_XT_TARGET_MARK=y
CONFIG_NETFILTER_XT_TARGET_NFLOG=y
CONFIG_NETFILTER_XT_TARGET_NFQUEUE=y
CONFIG_NETFILTER_XT_TARGET_SECMARK=y
CONFIG_NETFILTER_XT_TARGET_TCPMSS=y
CONFIG_NETFILTER_XT_MATCH_COMMENT=y
CONFIG_NETFILTER_XT_MATCH_CONNBYTES=y
CONFIG_NETFILTER_XT_MATCH_CONNLIMIT=y
CONFIG_NETFILTER_XT_MATCH_CONNMARK=y
CONFIG_NETFILTER_XT_MATCH_CONNTRACK=y
CONFIG_NETFILTER_XT_MATCH_HASHLIMIT=y
CONFIG_NETFILTER_XT_MATCH_HELPER=y
CONFIG_NETFILTER_XT_MATCH_IPRANGE=y
CONFIG_NETFILTER_XT_MATCH_LENGTH=y
CONFIG_NETFILTER_XT_MATCH_LIMIT=y
CONFIG_NETFILTER_XT_MATCH_MAC=y
CONFIG_NETFILTER_XT_MATCH_MARK=y
CONFIG_NETFILTER_XT_MATCH_MULTIPORT=y
CONFIG_NETFILTER_XT_MATCH_POLICY=y
CONFIG_NETFILTER_XT_MATCH_PKTTYPE=y
CONFIG_NETFILTER_XT_MATCH_QTAGUID=y
CONFIG_NETFILTER_XT_MATCH_QUOTA=y
CONFIG_NETFILTER_XT_MATCH_QUOTA2=y
CONFIG_NETFILTER_XT_MATCH_QUOTA2_LOG=y
CONFIG_NETFILTER_XT_MATCH_SOCKET=y
CONFIG_NETFILTER_XT_MATCH_STATE=y
CONFIG_NETFILTER_XT_MATCH_STATISTIC=y
CONFIG_NETFILTER_XT_MATCH_STRING=y
CONFIG_NETFILTER_XT_MATCH_TIME=y
CONFIG_NETFILTER_XT_MATCH_U32=y
CONFIG_NF_CONNTRACK_IPV4=y
CONFIG_IP_NF_IPTABLES=y
CONFIG_IP_NF_MATCH_AH=y
CONFIG_IP_NF_MATCH_ECN=y
CONFIG_IP_NF_MATCH_TTL=y
CONFIG_IP_NF_FILTER=y
CONFIG_IP_NF_TARGET_REJECT=y
CONFIG_NF_NAT_IPV4=y
CONFIG_IP_NF_TARGET_MASQUERADE=y
CONFIG_IP_NF_TARGET_NETMAP=y
CONFIG_IP_NF_TARGET_REDIRECT=y
CONFIG_IP_NF_MANGLE=y
CONFIG_IP_NF_RAW=y
CONFIG_IP_NF_SECURITY=y
CONFIG_IP_NF_ARPTABLES=y
CONFIG_IP_NF_ARPFILTER=y
CONFIG_IP_NF_ARP_MANGLE=y
CONFIG_NF_CONNTRACK_IPV6=y
CONFIG_IP6_NF_IPTABLES=y
CONFIG_IP6_NF_FILTER=y
CONFIG_IP6_NF_TARGET_REJECT=y
CONFIG_IP6_NF_MANGLE=y
CONFIG_IP6_NF_RAW=y
CONFIG_NF_NAT_IPV6=y
CONFIG_IP6_NF_TARGET_MASQUERADE=y
CONFIG_IP6_NF_TARGET_NPT=y
CONFIG_L2TP=y
CONFIG_MHI=y
CONFIG_NET_SCHED=y
CONFIG_NET_SCH_HTB=y
CONFIG_NET_SCH_PRIO=y
CONFIG_NET_CLS_FW=y
CONFIG_NET_CLS_U32=y
CONFIG_CLS_U32_MARK=y
CONFIG_NET_CLS_FLOW=y
CONFIG_NET_EMATCH=y
CONFIG_NET_EMATCH_CMP=y
CONFIG_NET_EMATCH_NBYTE=y
CONFIG_NET_EMATCH_U32=y
CONFIG_NET_EMATCH_META=y
CONFIG_NET_EMATCH_TEXT=y
CONFIG_NET_CLS_ACT=y
CONFIG_CFG80211=y
CONFIG_CFG80211_WEXT=y
CONFIG_RFKILL=y
CONFIG_NFC=y
CONFIG_UEVENT_HELPER_PATH="/sbin/hotplug"
CONFIG_PROC_DEVICETREE=y
CONFIG_BLK_DEV_LOOP=y
CONFIG_USB_SWITCH_RT8973=y
CONFIG_USE_MUIC=y
CONFIG_SENSORS_K2HH=y
CONFIG_SENSORS_ACC_16BIT=y
CONFIG_SENSORS_GP2AP002=y
CONFIG_SENSORS_HSCDTD008A=y
CONFIG_SENSORS_MAG_15BIT=y
CONFIG_UID_STAT=y
CONFIG_BCM_BT_RFKILL=y
CONFIG_BCM_BT_LPM=y
CONFIG_RMU2_CMT15=y
CONFIG_RWDT_CMT15_TEST=y
CONFIG_TPU_PWM=y
CONFIG_MD=y
CONFIG_BLK_DEV_DM=y
CONFIG_DM_DEBUG=y
CONFIG_DM_CRYPT=y
CONFIG_NETDEVICES=y
CONFIG_TUN=y
# CONFIG_ETHERNET is not set
CONFIG_PPP=y
CONFIG_PPP_BSDCOMP=y
CONFIG_PPP_DEFLATE=y
CONFIG_PPP_MPPE=y
CONFIG_PPPOE=y
CONFIG_PPPOL2TP=y
CONFIG_PPPOLAC=y
CONFIG_PPPOPNS=y
CONFIG_PPP_ASYNC=y
CONFIG_PPP_SYNC_TTY=y
CONFIG_WIFI_CONTROL_FUNC=y
CONFIG_BCMDHD=y
CONFIG_BCM_WLAN=y
CONFIG_INPUT_FF_MEMLESS=y
CONFIG_INPUT_POLLDEV=y
# CONFIG_INPUT_MOUSEDEV is not set
CONFIG_INPUT_EVDEV=y
CONFIG_KEYBOARD_GPIO=y
CONFIG_VIRTUAL_KEYBOARD=y
# CONFIG_INPUT_MOUSE is not set
CONFIG_INPUT_TOUCHSCREEN=y
CONFIG_TOUCHSCREEN_CYTTSP4=y
CONFIG_INPUT_UINPUT=y
# CONFIG_VT is not set
# CONFIG_LEGACY_PTYS is not set
CONFIG_SERIAL_SH_SCI=y
CONFIG_SERIAL_SH_SCI_CONSOLE=y
# CONFIG_HW_RANDOM is not set
CONFIG_TTY_STM=y
CONFIG_I2C_CHARDEV=y
CONFIG_I2C_GPIO=y
CONFIG_I2C_SH7730=y
CONFIG_I2C_SH_MOBILE=y
CONFIG_SPI=y
CONFIG_SPI_SH_MSIOF=y
CONFIG_SPI_SPIDEV=y
CONFIG_GPIO_SYSFS=y
CONFIG_BATTERY_D2153=y
CONFIG_CHARGER_SMB328A=y
CONFIG_SEC_CHARGING_FEATURE=y
CONFIG_BCM_INTER_SUPP=y
CONFIG_EOS2_RMTA_CTRL=y
CONFIG_THERMAL=y
CONFIG_CPU_THERMAL=y
CONFIG_SH_THERMAL=y
CONFIG_HOTPLUG_THERMAL=y
CONFIG_WATCHDOG=y
CONFIG_MFD_D2153=y
CONFIG_REGULATOR=y
CONFIG_REGULATOR_DUMMY=y
CONFIG_REGULATOR_D2153=y
CONFIG_MEDIA_SUPPORT=y
CONFIG_MEDIA_CAMERA_SUPPORT=y
CONFIG_V4L_PLATFORM_DRIVERS=y
CONFIG_SOC_CAMERA=y
CONFIG_SOC_CAMERA_PLATFORM=y
CONFIG_VIDEO_SH_MOBILE_CSI2=y
CONFIG_VIDEO_SH_MOBILE_RCU=y
CONFIG_SOC_CAMERA_S5K4ECGX=y
CONFIG_SOC_CAMERA_SR030PC50=y
CONFIG_ION=y
CONFIG_ION_R_MOBILE=y
CONFIG_FB=y
CONFIG_FB_SH_MOBILE_LCDC=y
CONFIG_LCD_CLASS_DEVICE=y
# CONFIG_BACKLIGHT_GENERIC is not set
CONFIG_BACKLIGHT_KTD3102=y
CONFIG_SOUND=y
CONFIG_SND=y
CONFIG_SND_SOC=y
CONFIG_SND_SOC_SH4_FSI=y
CONFIG_SND_FSI_D2153=y
CONFIG_SND_SOC_D2153_AAD=y
CONFIG_SND_SOC_SH_FSI_WIRELESS_TRANSCEIVER=y
CONFIG_HIDRAW=y
CONFIG_UHID=y
CONFIG_USB_GADGET=y
CONFIG_USB_R8A66597=y
CONFIG_USB_R8A66597_TYPE_BULK_PIPES_12=y
CONFIG_USB_G_ANDROID=y
CONFIG_MMC=y
CONFIG_MMC_UNSAFE_RESUME=y
CONFIG_MMC_BLOCK_MINORS=42
# CONFIG_MMC_BLOCK_BOUNCE is not set
CONFIG_MMC_RENESAS_MMCIF=y
CONFIG_MMC_RENESAS_SDHI=y
CONFIG_NEW_LEDS=y
CONFIG_LEDS_CLASS=y
CONFIG_LEDS_TRIGGERS=y
CONFIG_SWITCH=y
# CONFIG_RTC_INTF_PROC is not set
CONFIG_DMADEVICES=y
CONFIG_SH_DMAE=y
CONFIG_ASYNC_TX_DMA=y
CONFIG_STAGING=y
CONFIG_ZSMALLOC=y
CONFIG_ZRAM=y
CONFIG_ZRAM_DEBUG=y
CONFIG_ANDROID=y
CONFIG_ANDROID_BINDER_IPC=y
CONFIG_ASHMEM=y
CONFIG_ANDROID_LOGGER=y
CONFIG_ANDROID_LOW_MEMORY_KILLER=y
CONFIG_ANDROID_INTF_ALARM_DEV=y
CONFIG_SYNC=y
CONFIG_SW_SYNC=y
CONFIG_HWSEM_RMOBILE=y
CONFIG_NEW_SENSORS=y
CONFIG_SENSORS_CORE=y
# CONFIG_SAMSUNG_PARAM is not set
CONFIG_SMECO_CONTROL=y
CONFIG_VIBRATOR_SS=y
CONFIG_ARM_SEC_HAL=y
CONFIG_MEMLOG=y
CONFIG_EXT3_FS=y
CONFIG_EXT4_FS=y
CONFIG_EXT4_FS_SECURITY=y
CONFIG_FUSE_FS=y
CONFIG_VFAT_FS=y
CONFIG_TMPFS=y
CONFIG_ECRYPT_FS=y
CONFIG_WTL_ENCRYPTION_FILTER=y
CONFIG_CRAMFS=y
CONFIG_CRAMFS_LINEAR=y
CONFIG_ROOT_CRAMFS_LINEAR=y
CONFIG_NFS_FS=y
CONFIG_ROOT_NFS=y
CONFIG_NLS_CODEPAGE_437=y
CONFIG_NLS_ISO8859_1=y
CONFIG_NLS_UTF8=y
CONFIG_PRINTK_TIME=y
CONFIG_PRINTK_CPU_ID=y
CONFIG_PRINTK_PID=y
CONFIG_FRAME_WARN=2048
CONFIG_MAGIC_SYSRQ=y
CONFIG_PANIC_ON_OOPS=y
# CONFIG_DEBUG_PREEMPT is not set
CONFIG_DEBUG_INFO=y
CONFIG_SCHED_TRACER=y
CONFIG_DEBUG_USER=y
CONFIG_DEBUG_LL=y
CONFIG_EARLY_PRINTK=y
CONFIG_KEYS=y
CONFIG_KEYS_DEBUG_PROC_KEYS=y
CONFIG_SECURITY=y
CONFIG_SECURITY_NETWORK=y
CONFIG_SECURITY_NETWORK_XFRM=y
CONFIG_SECURITY_SELINUX=y
CONFIG_CRYPTO_NULL=y
CONFIG_CRYPTO_PCBC=y
CONFIG_CRYPTO_MD4=y
CONFIG_CRYPTO_MICHAEL_MIC=y
CONFIG_CRYPTO_SHA256=y
CONFIG_CRYPTO_TWOFISH=y
# CONFIG_CRYPTO_ANSI_CPRNG is not set
CONFIG_AVERAGE=y
```
